#include "MUSIC.h"
#include <cstdlib>
#include "readMatFile.h"
#include <string>
#include <iostream>
#include <stdio.h>
#include <complex>
#include <array>

#define NUM_SNAPSHOTS 128

//Function which tests estimate DOA cov function, with a covariane matrix
//generated by a Matlab script
// TODO : Add unit testing capabilities
void testEstimateDOA_cov();

//Function which tests the full estimateDOA function, 
//with simulated real valued input to the ADC (from a 
//Matlab script)
void testEstimateDOA(); 

int main(){
    testEstimateDOA_cov();
    std::cout << "\n"; 
    testEstimateDOA();
    return 0; 
}

void testEstimateDOA_cov(){
    std::cout << "*** Testing estimateDOA_cov() ***\n";
    std::cout << "Expected DOAs are [80, -40]\n";

    DOA estimator = DOA(400000); 
    const char * testFile = std::getenv("MUSIC_SINGLE_COV_FILE");
    if(!testFile){
        std::cout << "Set MUSIC_SINGLE_COV_FILE environment variable to the name of the .mat file for testing\n";
        return;
    }
    Eigen::MatrixXcf cov = extractVarToEigen(testFile, std::string("R_xx"));

#ifdef DEBUG
    std::cout << "Covariance Matrix (provided)\n";
    std::cout << cov; 
    std::cout << "\n";
#endif
    auto res = estimator.estimateDOA_cov(cov);

    //Search for peaks 
    // Print top N peaks
    std::cout << "\n=== TOP " << N_signals << " PEAKS ===\n";
    for (int i = 0; i < std::min(N_signals, (int)res.size()); i++) {
        std::cout << "Peak " << i+1 << ": Angle = " << (res[i].idx - 90) 
                  << " degrees, Value = " << res[i].val << "\n";
    }
}
void testEstimateDOA(){
    std::cout << "*** Testing estimateDOA ***\n";
    std::cout << "Expected DOAs are [80, -40]\n";
    DOA estimator = DOA(400000); 

    //std::vector<float> samples = extractVarToVec("Single_Real.mat", std::string("X_real"));
    const char * testFile = std::getenv("MUSIC_SINGLE_FILE");
    if(!testFile){
        std::cout << "Set MUSIC_SINGLE_FILE environment variable to the name of the .mat file for testing\n";
        return;
    }
    std::vector<float> samples = extractVarToVec(testFile, std::string("X_real_noisy"));
#ifdef DEBUG
    std::cout << "Signal Real (X_real)\n";
    for(size_t i = 0; i < samples.size(); i++){
        std::cout << samples[i] << "\n";
    }
    std::cout << "\n"; 
#endif
    auto res = estimator.estimateDOA(samples.data());
    
    std::vector<struct Peak> top_results = std::vector<struct Peak>();
    //Search for peaks 
    // Print top N peaks
    std::cout << "\n=== TOP " << N_signals << " PEAKS ===\n";
    for (int i = 0; i < std::min(N_signals, (int)res.size()); i++) {
        std::cout << "Peak " << i+1 << ": Angle = " << (res[i].idx - 90) 
                  << " degrees, Value = " << res[i].val << "\n";
        top_results.emplace_back(Peak{res[i].idx - 90, res[i].val});
    }

    std::cout << "Followup \n"; 
    for (int i = 0; i < std::min(5, (int)res.size()); i++) {
        std::cout << "Peak " << i+1 << ": Angle = " << (res[i].idx - 90) 
                  << " degrees, Value = " << res[i].val << "\n";
    }
    

#ifdef TEST
    std::cout << top_results.size() << "\n";
    d_write_res(top_results, "estimated_doas_music"); 
#endif
}


